## boards/shields/cirque40/Kconfig.defconfig
```kconfig
if SHIELD_CIRQUE40

# Name must be less than 16 characters long!
config ZMK_KEYBOARD_NAME
    default "cirque40"

# Cirque Glidepoint trackpad
config ZMK_POINTING
    default y

# Assuming pointing device uses SPI
config SPI
    default y
endif
```

## boards/shields/cirque40/Kconfig.shield
```kconfig
# No whitespace after the comma or in your keyboard name!
config SHIELD_CIRQUE40
    def_bool $(shields_list_contains,cirque40)
```
